## conf/layer.conf
```bitbake
# We might have a conf and classes directory, append to BBPATH
BBPATH .= ":${LAYERDIR}"

# We have a recipes directory, add to BBFILES
BBFILES += "${LAYERDIR}/recipes*/*/*.bb ${LAYERDIR}/recipes*/*/*.bbappend"

BBFILE_COLLECTIONS += "meta-96boards"
BBFILE_PATTERN_meta-96boards := "^${LAYERDIR}/"
BBFILE_PRIORITY_meta-96boards = "8"
LAYERSERIES_COMPAT_meta-96boards = "sumo thud warrior zeus"
LAYERDEPENDS_meta-96boards = "openembedded-layer meta-python"

SIGGEN_EXCLUDE_SAFE_RECIPE_DEPS += "\
    96boards-tools->e2fsprogs \
    96boards-tools->util-linux \
    96boards-tools->gptfdisk \
    96boards-tools->parted \
    96boards-tools->udev \
    96boards-tools->eudev \
"
```

## conf/machine/96boards-32.conf
```bitbake
#@TYPE: Machine
#@NAME: generic 96boards armv7a machine
#@DESCRIPTION: generic 96boards armv7a machine

require conf/machine/include/tune-cortexa8.inc

PREFERRED_PROVIDER_virtual/xserver ?= "xserver-xorg"

XSERVER ?= "xserver-xorg \
            mesa-driver-swrast \
            xf86-input-evdev \
            xf86-input-mouse \
            xf86-video-modesetting \
            xf86-input-keyboard"

MACHINE_FEATURES = "usbhost usbgadget alsa screen wifi bluetooth efi"

PREFERRED_PROVIDER_virtual/kernel ?= "linux-96boards"

KERNEL_IMAGETYPE = "Image"
# Fix me
KERNEL_DEVICETREE = ""

SERIAL_CONSOLE = "115200 ttyAMA0"

# Fastboot expects an ext4 image
IMAGE_FSTYPES_append = " ext4.gz"
```

## conf/machine/96boards-64.conf
```bitbake
#@TYPE: Machine
#@NAME: generic 96boards armv8 machine
#@DESCRIPTION: generic 96boards armv8 machine

require conf/machine/include/arm/arch-armv8.inc

PREFERRED_PROVIDER_virtual/xserver ?= "xserver-xorg"

XSERVER ?= "xserver-xorg \
            mesa-driver-swrast \
            xf86-input-evdev \
            xf86-input-mouse \
            xf86-video-modesetting \
            xf86-input-keyboard"

MACHINE_FEATURES = "usbhost usbgadget alsa screen wifi bluetooth efi"

PREFERRED_PROVIDER_virtual/kernel ?= "linux-96boards"

KERNEL_IMAGETYPE = "Image"
# Fix me
KERNEL_DEVICETREE = "hisilicon/hi6220-hikey.dtb qcom/apq8016-sbc.dtb"

SERIAL_CONSOLE = "115200 ttyAMA0"

# Fastboot expects an ext4 image
IMAGE_FSTYPES_append = " ext4.gz"
```

## conf/machine/bubblegum.conf
```bitbake
#@TYPE: Machine
#@NAME: uCRobotics Bubblegum machine
#@DESCRIPTION: uCRobotics Bubblegum machine

require conf/machine/include/arm/arch-armv8.inc

PREFERRED_PROVIDER_virtual/xserver ?= "xserver-xorg"

XSERVER ?= "xserver-xorg \
            mesa-driver-swrast \
            xf86-input-evdev \
            xf86-video-fbdev \
           "
           
MACHINE_FEATURES = "usbhost usbgadget alsa screen wifi bluetooth ext2 efi "

PREFERRED_PROVIDER_virtual/kernel ?= "linux-bubblegum"

KERNEL_IMAGETYPE = "Image"
KERNEL_DEVICETREE = "s900_96board.dtb"

SERIAL_CONSOLE = "115200 ttyS5"

MACHINE_ESSENTIAL_EXTRA_RDEPENDS += "\
    grub-efi \
"

# Pick the right subpackage, instead of the few hundred megs large main package
MACHINE_ESSENTIAL_EXTRA_RRECOMMENDS += "linux-firmware \
                                       "

CMDLINE_ROOT_EMMC   = "mmcblk0p3"
CMDLINE_ROOT_SDCARD = "mmcblk1p2"
CMDLINE ?= "console=ttyS5,115200n8 root=/dev/${CMDLINE_ROOT_EMMC} rootwait rw quiet"

# Fastboot expects an ext4 image, which needs to be 4096 bytes aligned
IMAGE_FSTYPES_append = " ext4.gz"
IMAGE_ROOTFS_ALIGNMENT = "4096"
EXTRA_IMAGECMD_ext4 += " -L SYSTEM "

EXTRA_IMAGEDEPENDS = "grub-efi"
```

## conf/machine/hikey-32.conf
```bitbake
#@TYPE: Machine
#@NAME: LeMaker HiKey machine
#@DESCRIPTION: LeMaker HiKey machine

require conf/machine/include/tune-cortexa8.inc

PREFERRED_PROVIDER_virtual/xserver ?= "xserver-xorg"

XSERVER ?= "xserver-xorg \
            mesa-driver-swrast \
            xf86-input-evdev \
            xf86-video-fbdev"

MACHINE_FEATURES = "usbhost usbgadget alsa screen wifi bluetooth ext2 efi mali450"

KERNEL_IMAGETYPE = "Image"
KERNEL_DEVICETREE = "hisilicon/hi6220-hikey.dtb"

SERIAL_CONSOLE = "115200 ttyAMA3"

CMDLINE_ROOT_EMMC   = "mmcblk0p9"
CMDLINE_ROOT_SDCARD = "mmcblk1p2"
CMDLINE ?= "console=ttyAMA3,115200n8 root=/dev/${CMDLINE_ROOT_EMMC} rootwait rw quiet efi=noruntime"

# Fastboot expects an ext4 image, which needs to be 4096 bytes aligned
IMAGE_FSTYPES_append = " ext4.gz"
IMAGE_ROOTFS_ALIGNMENT = "4096"
EXTRA_IMAGECMD_ext4 += " -L rootfs "

# Don't include kernels in this image.
# To run a 32bit userspace you need build
# the 64bit Kernel seperately.
# See: https://github.com/96boards/oe-rpb-manifest/blob/krogoth/setup-environment-internal

RDEPENDS_kernel-base = ""

PREFERRED_PROVIDER_virtual/kernel ?= "linux-dummy"

KERNEL_IMAGETYPE = "zImage"
```

## conf/machine/hikey.conf
```bitbake
#@TYPE: Machine
#@NAME: LeMaker HiKey machine
#@DESCRIPTION: LeMaker HiKey machine

require conf/machine/include/arm/arch-armv8.inc

PREFERRED_PROVIDER_virtual/xserver ?= "xserver-xorg"

XSERVER ?= "xserver-xorg \
            mesa-driver-swrast \
            xf86-input-evdev \
            xf86-video-fbdev \
           "

MACHINE_FEATURES = "usbhost usbgadget alsa screen wifi bluetooth ext2 efi optee mali450"

PREFERRED_PROVIDER_virtual/kernel ?= "linux-hikey"

KERNEL_IMAGETYPE = "Image"
KERNEL_DEVICETREE = "hisilicon/hi6220-hikey.dtb"

CONSOLE_LINUX = "ttyAMA3"
CONSOLE_AOSP = "ttyFIQ0"
CONSOLE ?= "${CONSOLE_LINUX}"
SERIAL_CONSOLES = "115200;${CONSOLE}"

MACHINE_ESSENTIAL_EXTRA_RDEPENDS += "\
    edk2-hikey \
    grub-efi \
"

MACHINE_ESSENTIAL_EXTRA_RRECOMMENDS += "linux-firmware-wl12xx \
                                        linux-firmware-wl18xx \
                                        kernel-module-btwilink \
                                        kernel-module-st-drv \
                                        kernel-module-wl18xx \
                                        kernel-module-wlcore \
                                        kernel-module-wlcore-sdio \
                                        kernel-module-ti-conf-wl18xx \
                                       "

CMDLINE_ROOT_EMMC   = "mmcblk0p9"
CMDLINE_ROOT_SDCARD = "mmcblk1p2"
CMDLINE ?= "console=${CONSOLE},115200n8 root=/dev/${CMDLINE_ROOT_EMMC} rootwait rw quiet efi=noruntime"

# Fastboot expects an ext4 image, which needs to be 4096 bytes aligned
IMAGE_FSTYPES_append = " ext4.gz"
IMAGE_ROOTFS_ALIGNMENT = "4096"
EXTRA_IMAGECMD_ext4 += " -L rootfs "

EXTRA_IMAGEDEPENDS = "edk2-hikey grub-efi burn-boot"

# Ensure we have enough free space to deploy tests
IMAGE_ROOTFS_EXTRA_SPACE = "1048576"
```

## conf/machine/hikey960.conf
```bitbake
#@TYPE: Machine
#@NAME: HiKey960 machine
#@DESCRIPTION: HiKey960 development board

require conf/machine/include/arm/arch-armv8.inc

PREFERRED_PROVIDER_virtual/xserver ?= "xserver-xorg"

XSERVER ?= "xserver-xorg \
            mesa-driver-swrast \
            xf86-input-evdev \
            xf86-video-fbdev \
           "

MACHINE_FEATURES = "usbhost usbgadget alsa screen wifi bluetooth ext2 efi"

PREFERRED_PROVIDER_virtual/kernel ?= "linux-hikey960"

KERNEL_IMAGETYPE = "Image"
KERNEL_DEVICETREE = "hisilicon/hi3660-hikey960.dtb"

SERIAL_CONSOLE = "115200 ttyAMA6"

MACHINE_ESSENTIAL_EXTRA_RDEPENDS += "\
    edk2-hikey960 \
    grub-efi \
"

MACHINE_ESSENTIAL_EXTRA_RRECOMMENDS += "linux-firmware-wl12xx \
                                        linux-firmware-wl18xx \
                                        kernel-module-btwilink \
                                        kernel-module-st-drv \
                                        kernel-module-wl18xx \
                                        kernel-module-wlcore \
                                        kernel-module-wlcore-sdio \
                                        kernel-module-ti-conf-wl18xx \
                                       "

CMDLINE_ROOT_EMMC   = "sdd10"
CMDLINE_ROOT_SDCARD = "mmcblk1p2"
CMDLINE ?= "console=ttyAMA6,115200n8 root=/dev/${CMDLINE_ROOT_EMMC} rootwait rw quiet efi=noruntime"

# Fastboot expects an ext4 image, which needs to be 4096 bytes aligned
IMAGE_FSTYPES_append = " ext4.gz"
IMAGE_ROOTFS_ALIGNMENT = "4096"
EXTRA_IMAGECMD_ext4 += " -L rootfs "

EXTRA_IMAGEDEPENDS = "edk2-hikey960 grub-efi"

# FIXME unless we set image rootfs extra space, the generated image is corrupted.
IMAGE_ROOTFS_EXTRA_SPACE = "1048576"
```

## conf/machine/hikey970.conf
```bitbake
#@TYPE: Machine
#@NAME: HiKey970 machine
#@DESCRIPTION: HiKey970 development board

require conf/machine/include/arm/arch-armv8.inc

PREFERRED_PROVIDER_virtual/xserver ?= "xserver-xorg"

XSERVER ?= "xserver-xorg \
            mesa-driver-swrast \
            xf86-input-evdev \
            xf86-video-fbdev \
           "

MACHINE_FEATURES = "usbhost usbgadget alsa screen wifi bluetooth ext2 efi"

PREFERRED_PROVIDER_virtual/kernel ?= "linux-hikey970"

KERNEL_IMAGETYPE = "Image"
KERNEL_DEVICETREE = "hisilicon/kirin970-hikey970.dtb"

SERIAL_CONSOLE = "115200 ttyAMA6"

MACHINE_ESSENTIAL_EXTRA_RDEPENDS += "\
    edk2-hikey970 \
    grub \
"

MACHINE_ESSENTIAL_EXTRA_RRECOMMENDS += "linux-firmware-wl12xx \
                                        linux-firmware-wl18xx \
                                        kernel-module-btwilink \
                                        kernel-module-st-drv \
                                        kernel-module-wl18xx \
                                        kernel-module-wlcore \
                                        kernel-module-wlcore-sdio \
                                        kernel-module-ti-conf-wl18xx \
                                       "

CMDLINE_ROOT_EMMC   = "sdd12"
CMDLINE ?= "earlycon=pl011,0xfff32000,115200 clk_ignore_unused=true console=ttyAMA6,115200n8 root=/dev/${CMDLINE_ROOT_EMMC} rootwait rw quiet efi=noruntime"

# Fastboot expects an ext4 image, which needs to be 4096 bytes aligned
IMAGE_FSTYPES_append = " ext4.gz"
IMAGE_ROOTFS_ALIGNMENT = "4096"
EXTRA_IMAGECMD_ext4 += " -L rootfs "

EXTRA_IMAGEDEPENDS = "edk2-hikey970 grub"

# FIXME unless we set image rootfs extra space, the generated image is corrupted.
IMAGE_ROOTFS_EXTRA_SPACE = "1048576"
```

## conf/machine/juno.conf
```bitbake
#@TYPE: Machine
#@NAME: Juno vexpress
#@DESCRIPTION: Juno ARM Development Platform

require conf/machine/include/arm/arch-armv8.inc

PREFERRED_PROVIDER_virtual/xserver ?= "xserver-xorg"

XSERVER ?= "xserver-xorg \
            mesa-driver-swrast \
            xf86-input-evdev \
            xf86-input-mouse \
            xf86-video-fbdev \
            xf86-input-keyboard"

MACHINE_FEATURES = "usbhost usbgadget alsa screen wifi bluetooth optee"

PREFERRED_PROVIDER_virtual/kernel ?= "linux-juno"

KERNEL_IMAGETYPE = "Image"
KERNEL_DEVICETREE = "arm/juno.dtb arm/juno-r1.dtb arm/juno-r2.dtb"

OPTEEMACHINE = "vexpress-juno"
OPTEEOUTPUTMACHINE = "vexpress"

SERIAL_CONSOLE = "115200 ttyAMA0"

# Juno can boot with UEFI or U-Boot
#EXTRA_IMAGEDEPENDS = "edk2"
UBOOT_MACHINE = "vexpress_aemv8a_juno_defconfig"

MACHINE_ESSENTIAL_EXTRA_RDEPENDS = "u-boot-juno atf-juno"
EXTRA_IMAGEDEPENDS = "u-boot-juno atf-juno"
```

## conf/machine/orangepi-i96.conf
```bitbake
#@TYPE: Machine
#@NAME: OrangePi i96 machine
#@DESCRIPTION: OrangePi i96 machine

require conf/machine/include/tune-cortexa5.inc

PREFERRED_PROVIDER_virtual/xserver ?= "xserver-xorg"

XSERVER ?= "xserver-xorg \
            mesa-driver-swrast \
            xf86-input-evdev \
            xf86-video-fbdev \
"

MACHINE_FEATURES = "usbhost usbgadget alsa screen wifi bluetooth ext2"

PREFERRED_PROVIDER_virtual/kernel ?= "linux-orangepi-i96"

KERNEL_IMAGETYPE = "zImage"
#KERNEL_DEVICETREE = "currently-uses-a-concatenated-dt"

UBOOT_MACHINE = "rda8810_config"
UBOOT_SUFFIX = "rda"

# TODO: Switch this to LS-UART1 and reduce to 115200 (921600 is needed
#       on ttyS0 in order to match speeds with the boot ROM output
SERIAL_CONSOLES = "921600;ttyS0"

MACHINE_ESSENTIAL_EXTRA_RDEPENDS += "\
    u-boot-orangepi-i96 \
"

CMDLINE_ROOT_EMMC = "mmcblk0p2"
CMDLINE ?= "console=ttyS0,921600 root=/dev/${CMDLINE_ROOT_EMMC} rootwait rw quiet"

# Fastboot expects an ext4 image, which needs to be 4096 bytes aligned
IMAGE_FSTYPES_append = " ext4.gz"
IMAGE_ROOTFS_ALIGNMENT = "4096"
EXTRA_IMAGECMD_ext4 += " -L rootfs "

EXTRA_IMAGEDEPENDS = "u-boot-orangepi-i96"
```

## conf/machine/poplar.conf
```bitbake
#@TYPE: Machine
#@NAME: ToCoding Poplar machine
#@DESCRIPTION: ToCoding Poplar machine

require conf/machine/include/arm/arch-armv8.inc

PREFERRED_PROVIDER_virtual/xserver ?= "xserver-xorg"

XSERVER ?= "xserver-xorg \
            mesa-driver-swrast \
            xf86-input-evdev \
            xf86-video-fbdev \
           "

MACHINE_FEATURES = "usbhost usbgadget alsa screen ext2"

PREFERRED_PROVIDER_virtual/kernel ?= "linux-poplar"

KERNEL_IMAGETYPE = "Image"
KERNEL_DEVICETREE = "hisilicon/hi3798cv200-poplar.dtb"

UBOOT_MACHINE = "poplar_defconfig"

SERIAL_CONSOLES = "115200;ttyAMA0"

MACHINE_ESSENTIAL_EXTRA_RDEPENDS += "\
    atf-poplar \
    l-loader-poplar \
    u-boot-poplar \
"

CMDLINE_ROOT_EMMC   ?= "mmcblk1p3"
CMDLINE ?= "console=ttyAMA0,115200n8 root=/dev/${CMDLINE_ROOT_EMMC} rootwait rw quiet"

# Fastboot expects an ext4 image, which needs to be 4096 bytes aligned
IMAGE_FSTYPES_append = " ext4.gz"
IMAGE_ROOTFS_ALIGNMENT = "4096"
EXTRA_IMAGECMD_ext4 += " -L rootfs "

EXTRA_IMAGEDEPENDS = "atf-poplar l-loader-poplar u-boot-poplar"
```

## conf/machine/vexpress-juno.conf
```bitbake
#@TYPE: Machine
#@NAME: Juno vexpress
#@DESCRIPTION: generic machine to be used by linaro-media-create

require conf/machine/include/arm/arch-armv8.inc

PREFERRED_PROVIDER_virtual/xserver ?= "xserver-xorg"

XSERVER ?= "xserver-xorg \
            mesa-driver-swrast \
            xf86-input-evdev \
            xf86-input-mouse \
            xf86-video-fbdev \
            xf86-input-keyboard"

MACHINE_FEATURES = "usbhost usbgadget alsa screen wifi bluetooth efi optee"

PREFERRED_PROVIDER_virtual/kernel ?= "linux-96boards"

KERNEL_IMAGETYPE = "Image"
KERNEL_DEVICETREE = "arm/juno.dtb arm/juno-r1.dtb arm/juno-r2.dtb"

OPTEEOUTPUTMACHINE = "vexpress"

SERIAL_CONSOLE = "115200 ttyAMA0"

EXTRA_IMAGEDEPENDS = "edk2"
```
